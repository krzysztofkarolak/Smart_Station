/*
   ESP-12-01 V9_A1
   Copyright 2018 Krzysztof Karolak

   ESP12-based LCD weather station, IR remote, blind and fan controller, sharing data with external devices.

   OTA Settings - 115200 4M(1M SPIFFS)


   ESP-12 PHYSICAL PINOUT

   GP0 - FAN SPEED / FLASH
   GP01 - TXD
   GP02 - ESP LED / BLIND UP
   GP03 - RXD / WS2812B LED DATA
   GP04,05 - I2C OLED SCREEN
   GP12 - IR LED
   GP13 - DS18B20 TEMPERATURE SENSOR
   GP14 - PHYSICAL BUTTON
   GP15 - BLIND DOWN
   GP16 - PIR MOTION SENSOR

   VIRTUAL PINOUT

   EXT - External Data (received from server)

   V0 - TEMPERATURE OUTSIDE (tempOut)
   V1 - TEMPERATURE INSIDE (tempIn) (EXT)
   V2 - UPTIME
   V3 - TERMINAL WIDGET
   V4 - BRIDGE WIDGET
   V5 - PIR SENSOR STATE
   V6 - PIR SENSOR ON/OFF
   V7 - BLIND UP
   V8 - BLIND DOWN
   V9 - LCD ON/OFF/DIM/PIR
   V10 - TERMINAL
   V11 - FAN STATE LED
   V12 - FAN MANUAL LOCK
   V13 -
   V14 - RGB LEDS COLOR
   V15 - RGB LEDS ANIMATION/MODE
   V16 - RGB LEDS BRIGHTNESS
   V17 - IR REMOTE COMMAND (LG TV)
   V18 - IR REMOTE COMMAND (Panasonic DVD)
   V19 - IR REMOTE Auto On/Off Sequence (Panasonic DVD)
   V36 - Air Quality Color (EXT)
   V37 - Air Quality Description (EXT)
   V38 - HUMIDITY (EXT)
   V39 - PM1 (EXT)
   V40 - PM2.5 (EXT)
   V41 - PM10 (EXT)
   V42 - POISONING LEVEL (EXT)
   V43 - TEMP (EXT)
   V44 - CAQI (EXT)
   V45 - FAN LOCK STATE (EXT)
   V46 - UPDATE DATE (EXT)
   V47 - WIND SPEED (EXT)
   V48 - WIND DIRECTION (EXT)
   V49 - PRESSURE (EXT)
   V50 - SPOTIFY CURRENT TRACK INFO (EXT)
   V51 - SPOTIFY CURRENT ALBUM COLOR RGB (EXT)
   V60 - BRIDGE (WEMOS01-RADIATOR)
   V61 - AUTO RADIATOR ON/OFF
   V62 - RADIATOR TARGET TEMPERATURE
   V63 - STATUS RECEIVER FROM BRIDGE
   V64 - CONFIRMATION STATUS RECEIVER FROM BRIDGE
   V65 - OWNER HOME SETTING ON/OFF
   V66 - RADIATOR LOCAL LEVEL
   V70 - CONDITIONS (EXT)
   V71 - UPDATE SERVER NAME (EXT)
   V72 - CONDITIONS CODE (YAHOO) (EXT)

   VIRTUAL PINS (OLD)

   V1 - TEMP IN (tempIn) (EXT)
   V2 - TEMP OUT (tempOut)
   V4 - PRESSURE (EXT)
   V5 - ATTITUDE (EXT)
   V6 - UPTIME
   V10 - WIDGET TERMINAL
   V12 - BLIND UP
   V14 - BLIND DOWN
   V20 - PIR AUTO STATE OPTION
   V21 - MANUAL LCD ON/OFF
   V27 - FAN STATE LED
   V28 - FAN MANUAL OFF LOCK
   V40 - PM2.5 (EXT)
   V41 - PM10 (EXT)
   V42 - POISONING LEVEL (EXT)
   V43 - TEMP (EXT)
   V44 - CAQI (EXT)
   V45 - FAN LOCK STATE (EXT)
   V46 - UPDATE DATE (EXT)
   V47 - WIND SPEED (EXT)
   V48 - WIND DIRECTION (EXT)
   V49 - PRESSURE (EXT)
   V70 - CONDITIONS (EXT)
   V71 - UPDATE SERVER NAME (EXT)
   V72 - CONDITIONS CODE (YAHOO) (EXT)
*/

#include <ESP8266WiFi.h>
#include <BlynkSimpleEsp8266.h>
#include <SimpleTimer.h>
#include <OneWire.h>
#include <DallasTemperature.h>
#include <Wire.h>
#include <TimeLib.h>
#include <WidgetRTC.h>
#include <ESP8266mDNS.h>
#include <ArduinoOTA.h>
#include <IRremoteESP8266.h>
#include <IRsend.h>
#include <FastLED.h>
#include <SPI.h>
#include <Adafruit_GFX.h>
#include <Fonts/FreeSans9pt7b.h>
#include <Fonts/FreeSans12pt7b.h>
#include <Fonts/FreeSans18pt7b.h>
#include <Fonts/FreeSans24pt7b.h>
#include <Adafruit_SSD1306.h>


/* OLED */
#define OLED_RESET 1
Adafruit_SSD1306 display(OLED_RESET);

/* FastLED */
#define LED_PIN     3
#define NUM_LEDS    6
#define BRIGHTNESS  200
#define LED_TYPE    WS2812
#define COLOR_ORDER GRB
CRGB leds[NUM_LEDS];

#include "arduino_secrets.h" // Load passwords and API Keys

char auth[] = SECRET_APIKEY; // Blynk Token

/* Blynk Widgets Init */
WidgetRTC rtc;
WidgetTerminal terminal(V10); //commands
WidgetBridge bridgeWemos(V60);
/* ------------------------ */

#define IR_LED 12
IRsend irsend(IR_LED);
//panasonic ir codes raw
uint16_t rawDataPower[99] = { 3450, 1650, 450, 350, 450, 1250, 450, 400, 450, 400, 450, 400, 450,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 1250, 450 }; // UNKNOWN D5AD0B51
uint16_t  rawDataSubwoofer[99] = { 3450, 1650, 400, 400, 450, 1200, 500, 350, 450, 400, 400, 400, 450,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 400, 450 }; // UNKNOWN A96DB2FC
uint16_t  rawDataSleep[99] = { 3450, 1650, 400, 400, 450, 1250, 450, 400, 400, 400, 450, 400, 450,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 400, 450 }; // UNKNOWN 422122AE
uint16_t  rawDataVolUp[99] = { 3400, 1650, 450, 350, 500, 1200, 450, 350, 500, 350, 500, 350, 450,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 1250, 450 }; // UNKNOWN DE5526F7
uint16_t  rawDataVolDown[99] = { 3400, 1650, 450, 400, 450, 1300, 400, 350, 450, 400, 450, 400, 450,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 1250, 450 }; // UNKNOWN 8C549057
uint16_t  rawDataAux[99] = { 3400, 1700, 400, 400, 450, 1250, 450, 400, 450, 400, 450, 400, 450,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 400, 450 }; // UNKNOWN 75D994CE
uint16_t  rawDataEq[99] = { 3400, 1650, 450, 400, 450, 1200, 450, 400, 450, 350, 450, 400, 400,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 400, 450 }; // UNKNOWN 54308B58



/* OLED Bitmaps */

const unsigned char blynkLogo[] PROGMEM = {
	// 'blynk, 128x64px
	0x00, 0x00, 0x00, 0x00, 0x00, 0x00, 0x00, 0x00, 0x00, 0x00, 0x00, 0x00, 0x00, 0x00, 0x00, 0x00,
	0x00, 0x00, 0x00, 0x00, 0x00, 0x00, 0x00, 0x00, 0x00, 0x00, 0x00, 0x00, 0x00, 0x00, 0x00, 0x00,
	0x00, 0x00, 0x00, 0x00, 0x00, 0x00, 0x00, 0x00, 0x00, 0x00, 0x00, 0x00, 0x00, 0x00, 0x00, 0x00,
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	0x00, 0x00, 0x00, 0x00, 0x00, 0x00, 0x00, 0x00, 0x00, 0x00, 0x00, 0x00, 0x00, 0x00, 0x00, 0x00
};

const unsigned char temperatureScreen[] PROGMEM = {
	// 'temperatureicon, 128x64px
	0x00, 0x00, 0x00, 0x00, 0x00, 0x00, 0x00, 0x00, 0x00, 0x00, 0x00, 0x00, 0x00, 0x00, 0x00, 0x00,
	0x00, 0x00, 0x00, 0x00, 0x00, 0x00, 0x00, 0x00, 0x00, 0x00, 0x00, 0x00, 0x00, 0x00, 0x00, 0x00,
	0x00, 0x00, 0x00, 0x00, 0x00, 0x00, 0x00, 0x00, 0x00, 0x00, 0x00, 0x00, 0x00, 0x00, 0x00, 0x00,
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	0x00, 0x00, 0x00, 0x00, 0x00, 0x00, 0x00, 0x00, 0x00, 0x00, 0x00, 0x00, 0x00, 0x00, 0x00, 0x00
};

const unsigned char spotifyScreen[] PROGMEM = {
	// 'spotifyscreen, 128x64px
	0x00, 0x00, 0x00, 0x00, 0x00, 0x00, 0x00, 0x00, 0x00, 0x00, 0x00, 0x00, 0x00, 0x00, 0x00, 0x00,
	0x00, 0x00, 0x00, 0x00, 0x00, 0x00, 0x00, 0x00, 0x00, 0x00, 0x00, 0x00, 0x00, 0x00, 0x00, 0x00,
	0x00, 0x00, 0x00, 0x00, 0x00, 0x00, 0x00, 0x00, 0x00, 0x00, 0x00, 0x00, 0x00, 0x00, 0x00, 0x00,
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	0x00, 0x00, 0x00, 0x00, 0x00, 0x00, 0x00, 0x00, 0x00, 0x00, 0x00, 0x00, 0x00, 0x00, 0x00, 0x00
};

/* Timer object */
SimpleTimer timer;
/* Timer IDs */
int updateValuesTimer, fastTimer, autoDimTimer, pirTimer, radiatorStatusTimeout;

/* Function to check if string begins with something */
int StartsWith(const char *a, const char *b)
{
	if (strncmp(a, b, strlen(b)) == 0) return 1;
	return 0;
}

/* --------------------------------------------- */



/* Temperature sensors init */
#define ONE_WIRE_BUS 13
#define TEMPERATURE_PRECISION 12
OneWire oneWire(ONE_WIRE_BUS);
DallasTemperature temperatureSensors(&oneWire);
DallasTemperature sensors(&oneWire);
DeviceAddress OutsideTemp = { 0x28, 0xFF, 0x3, 0x5A, 0x90, 0x15, 0x3, 0x1C }; // Wodoodporny ds
/* ----------------------- */


/* Physical pins assignment */
unsigned char blindUpPin = 2, blindDownPin = 15, pirPin = 16, button1 = 14; // Physical pins assign

/* Variables assignment */
float tempOut, tempIn, airTemp = 0.0; // Temperature Inside, Outside
int pm25, pm10, caqi, airLevel = 0, weatherLockFan = 0, weatherCode = 0, screenMode = 0, displayState = 1, spotifyScreenOffset = 0; //data from server
unsigned char radiatorLocalLevel = 0, radiatorStatus = 0, radiatorTargetTemp;
String weatherCondPl = "No data", currentSpotifyArtist, currentSpotifyTrack, currentSpotifyTrackScreen;
boolean bootCounter = false, pirAutoState = true, pirAutoLedState = true, pirState, fanState = false, isMainScreen, fanLock = false;
boolean isSpotifyPlaying = false, tempLocalOutWrong = true, spotifyColorEnabled = false, spotifyTrackScroll = false, scrollTextEnabled = true, halfTime = false;
boolean radiatorAuto = false, ownerIsHomeSetting = true, radiatorIsOnline = false, ownerIsHome = false;

/* ---------------------- */

/* --------------- FastLED ---------------*/

void SetLedBrightness(int bValue) {
	FastLED.setBrightness(bValue);
	FastLED.show();
}

/* ------------------------------------- */

/* ------------ OLED ---------------- */

void sleepDisplay() {
	display.ssd1306_command(SSD1306_DISPLAYOFF);
	displayState = 0; //off
}

void wakeDisplay() {
	display.ssd1306_command(SSD1306_DISPLAYON);
}

void dimDisplay(bool state) {
	wakeDisplay();
	if (state) {
		display.dim(1); //dimmed contrast
	}
	else {
		display.dim(0); //normal contrast
	}
}

String GetTimeForScreen() {
	//time
	String formattedTime;
	int hr = hour();
	if (hr < 10) {
		formattedTime = "0";
	}
	formattedTime = formattedTime + String(hr) + ":";
	int mn = minute();
	if (mn < 10) {
		formattedTime = formattedTime + "0";
	}
	formattedTime = formattedTime + String(mn);
	return formattedTime;
}

String GetDateForScreen(bool includeWeekday = false) {
	//time
	String formattedDate;
	String weekDay;
	int dayInt = day();
	int mth = month();
	if (includeWeekday) {
		int weekDayInt = weekday();
		String weekDay;
		switch (weekDayInt) {
		case 1:
			weekDay = "niedz";
			break;
		case 2:
			weekDay = "pon";
			break;
		case 3:
			weekDay = "wt";
			break;
		case 4:
			weekDay = "sr";
			break;
		case 5:
			weekDay = "czw";
			break;
		case 6:
			weekDay = "pt";
			break;
		case 7:
			weekDay = "sob";
			break;
		}
		formattedDate = weekDay + ", " + String(dayInt) + "." + mth;
	}
	else {
		formattedDate = String(dayInt) + "." + mth;
	}
	return formattedDate;
}

void PrintTimeDateOnScreen() {
	display.setFont(&FreeSans9pt7b);
	PrintTextOnScreen(GetTimeForScreen() + " ", false, 0, 8, 12);
	display.setFont();
	PrintTextOnScreen(GetDateForScreen(true), false, 1, 60, 0);
}

void PrintTextOnScreen(String text, bool clearScreen, int textSize, int posX, int posY) {
	if (clearScreen) {
		display.clearDisplay();
	}
	display.setTextSize(textSize);
	display.setCursor(posX, posY);
	display.print(text);
}

void ScreenManager(int screenType, boolean halfTime = false) {
	switch (screenType) {
	case 0:
    
		//default main screen
		display.clearDisplay();

		PrintTimeDateOnScreen();

    if(halfTime) {
          display.drawBitmap(50, 0, temperatureScreen, 128, 64, 1);

          //Smog
          PrintTextOnScreen("Smog", false, 0, 13, 20);
          display.setFont(&FreeSans12pt7b);
          PrintTextOnScreen(String(airLevel), false, 0, 16, 50);
      
      		//Temperatures
      		display.setFont(&FreeSans9pt7b);
      		//outside
      		int tempForScreen;
      		if (tempLocalOutWrong) {
      			tempForScreen = airTemp;
      		}
      		else {
      			tempForScreen = tempOut;
      		}
      
      		PrintTextOnScreen(String(round(tempForScreen)), false, 1, 84, 30);
      		display.print((char)247); display.print("C");
      		//inside
      		PrintTextOnScreen(String(round(tempIn)), false, 1, 84, 50);
      		display.print((char)247); display.print("C");
    }
    else {
          display.drawBitmap(0, 5, temperatureScreen, 128, 64, 1);

          //Smog
          PrintTextOnScreen("Smog", false, 0, 88, 20);
          display.setFont(&FreeSans12pt7b);
          PrintTextOnScreen(String(airLevel), false, 0, 91, 50);
      
          //Temperatures
          display.setFont(&FreeSans9pt7b);
          //outside
          int tempForScreen;
          if (tempLocalOutWrong) {
            tempForScreen = airTemp;
          }
          else {
            tempForScreen = tempOut;
          }
      
          PrintTextOnScreen(String(round(tempForScreen)), false, 1, 34, 34);
          display.print((char)247); display.print("C");
          //inside
          PrintTextOnScreen(String(round(tempIn)), false, 1, 34, 50);
          display.print((char)247); display.print("C");
    }

		display.setFont();
		display.display();
		screenMode = 0;
		break;
	case 1:
		//bootscreen
		display.clearDisplay();
		display.drawBitmap(0, 0, blynkLogo, 128, 64, 1);
		display.display();
		screenMode = 1;
		break;
	case 2:
		display.clearDisplay();
		display.drawBitmap(0, 0, spotifyScreen, 128, 64, 1);
		PrintTimeDateOnScreen();
		if (currentSpotifyTrack.length() > 13) {
			spotifyTrackScroll = true;
		}
		else {
			spotifyTrackScroll = false;
			currentSpotifyTrackScreen = currentSpotifyTrack;
		}
		PrintTextOnScreen(currentSpotifyArtist.substring(0, 15), false, 1, 45, 20);
		PrintTextOnScreen(currentSpotifyTrackScreen, false, 1, 45, 30);
		display.display();
		screenMode = 2;
		break;
	}
}

void PirScreenState(bool state) {
	if (state && displayState == 0) {
		displayState = 1; //on
		wakeDisplay();
	}
	else if (!state) {
		sleepDisplay();
	}
}

BLYNK_WRITE(V9) // OLED SET ON/OFF/DIM/PIR
{
	switch (param.asInt()) {
	case 1: //off
		dimDisplay(false);
		displayState = 1; //on
		pirAutoLedState = false;
		timer.disable(pirTimer);
		break;
	case 2: //dim
		dimDisplay(true);
		displayState = 2; //dim
		pirAutoLedState = false;
		timer.disable(pirTimer);
		break;
	case 3: //off
		sleepDisplay();
		pirAutoLedState = false;
		timer.disable(pirTimer);
		break;
	case 4: //auto
		pirAutoLedState = true;
		timer.enable(pirTimer);
		break;
	}
}

void LcdScreenManager(int screenType, String message = "") {
	//lcd.clear();
	/*
	  switch(screenType) {
		//default main screen
		case 1:
		isMainScreen = true;
		LcdPrintDateTime(true);
		LcdPrintTemperatures();
		LcdWeatherIcon();
		LcdPollutionLevel();
		break;

		//large clock screen
		case 2:
		isMainScreen = false;
		break;
	  }
	*/
}

void LcdPrintTemperatures() {
	//outside temp
	/*lcd.setCursor(8,0);
	  lcd.print(" ");
	  lcd.write(5); //arrowUp
	  if(turnTemp) {
	  turnTemp = false;
	  lcd.print(airTemp,1);
	  lcd.print((char)223); //degree
	  lcd.print("N");
	  } else {
	  turnTemp = true;
	  lcd.print(to,1);
	  lcd.print((char)223); //degree
	  lcd.print("L");
	  }


	  //inside temp
	  lcd.setCursor(8,1);
	  lcd.print(" ");
	  lcd.write(6); //arrowDown
	  lcd.print(ti,1);
	  lcd.print((char)223); //degree
	*/
}


void LcdFanAnimation() {
	/*  if(isMainScreen) {
	   if(fanState) {
		fanAnimationFrame++;
		if(fanAnimationFrame>3) { //4 frames
		 fanAnimationFrame = 0;
		}
	   }
	   else {
		 fanAnimationFrame = 0;
	   }

	   //put frame on screen
		lcd.createChar(0, arrows[fanAnimationFrame]); //create the character on position
		lcd.setCursor(15,1);
		lcd.write((byte)0); // write the character in lcd.createChar to the LCD

	  }
	*/
}

void LcdWeatherIcon() {
	GeneralizeWeatherCode();
	//hint: weather code as array
}

void LcdPollutionLevel() {
	if (airLevel < 10 && airLevel > 0) {
		// lcd.print(airLevel);
	}
}

/* -------------------------------------------------- */


/* --------- WEATHER CONDITION CODES --------- */

BLYNK_WRITE(V72) {
	weatherCode = param.asInt();
}

void GeneralizeWeatherCode() {
	/*
	  if(((weatherCode>=0) && (weatherCode<=2)) || (weatherCode==24) || ((weatherCode>=23) && (weatherCode<=24))) {
	  //hurricane, tornado, wind
	  icon1WeatherCode=8;
	  icon2WeatherCode=9;
	  }
	  else if(((weatherCode>=3) && (weatherCode<=4)) || ((weatherCode>=37) && (weatherCode<=39)) || (weatherCode==47)) {
	  //thunderstorms
	  icon1WeatherCode=5;
	  icon2WeatherCode=10;
	  }
	  else if(((weatherCode>=6) && (weatherCode<=12)) || (weatherCode==40) || (weatherCode==45)) {
	  //showers, drizzle
	  icon1WeatherCode=2;
	  icon2WeatherCode=3;
	  }
	  else if((weatherCode==5) || (weatherCode==35) || ((weatherCode>=13) && (weatherCode<=18)) || ((weatherCode>=41) && (weatherCode<=43)) || (weatherCode==46)) {
	  //snow, hail
	  icon1WeatherCode=4;
	  icon2WeatherCode=12;
	  }
	  else if((weatherCode==25) || ((weatherCode>=19) && (weatherCode<=22))) {
	  //haze, dust, foggy, cold
	  icon1WeatherCode=5;
	  icon2WeatherCode=11;
	  }
	  else if((weatherCode>=26) && (weatherCode<=30)) {
	  //cloudy
	  icon1WeatherCode=4;
	  icon2WeatherCode=5;
	  }
	  else if((weatherCode==36) || (weatherCode==34) || (weatherCode==32) || (weatherCode==44)) {
	  //sunny (day)
	  icon1WeatherCode=0;
	  icon2WeatherCode=1;
	  }
	  else if((weatherCode==31) || (weatherCode==33)) {
	  //sunny (night)
	  icon1WeatherCode=6;
	  icon2WeatherCode=7;
	  }
	  else {
	  icon1WeatherCode=0;
	  icon2WeatherCode=1;
	  }
	*/
}


/* ------------- FAN --------- */

BLYNK_WRITE(V12) // Manual Fan lock
{
	// Fan lock on/off
	if (param.asInt()) {
		fanLock = true;
	}
	else {
		fanLock = false;
	}
}

/* ---------------------------- */


/* -------- BLIND -------------- */

BLYNK_WRITE(V7) {
	if (param.asInt()) {
		timer.disable(updateValuesTimer); // Disable screen/data updates for best performance
		timer.disable(fastTimer);
		/*  lcd.clear();
		  lcd.setCursor(0,0);
		  lcd.print("   ROLETA ");
		  lcd.write(5); //arrow up
		*/
		digitalWrite(blindUpPin, HIGH);
	}
	else {
		digitalWrite(blindUpPin, LOW);
		timer.enable(updateValuesTimer);
		timer.enable(fastTimer);
		//LcdScreenManager(1); Back to main screen
	}
}

BLYNK_WRITE(V8) {
	if (param.asInt()) {
		timer.disable(updateValuesTimer); // Disable screen/data updates for best performance
		/*    lcd.clear();
			lcd.setCursor(0,0);
			lcd.print("   ROLETA ");
			lcd.write(6); //arrow down
		*/
		digitalWrite(blindDownPin, HIGH);
	}
	else {
		digitalWrite(blindDownPin, LOW);
		timer.enable(updateValuesTimer);
		//LcdScreenManager(1); Back to main screen
	}
}

/* ------------------------------ */


/* ------- FastLED --------------*/

//leds color
BLYNK_WRITE(V14) {
  if(param[3].asInt()) {
    leds[param[3].asInt()] = CRGB(param[0].asInt(), param[1].asInt(), param[2].asInt()); //fill single led
  }
  else {
	  fill_solid(leds, NUM_LEDS, CRGB(param[0].asInt(), param[1].asInt(), param[2].asInt())); //fill all leds
  }
	FastLED.show();
}

//leds brightness
BLYNK_WRITE(V16) {
	SetLedBrightness(param.asInt());
}

/* IR LED */

//LG TV
BLYNK_WRITE(V17) {
	switch (param.asInt()) {
	case 1:
		irsend.sendNEC(0x20DF10EF, 32); // LGTV power
		break;
	case 2:
		irsend.sendNEC(0x20DFA956, 32); //ECO mode
		break;
	case 3:
		irsend.sendNEC(0x20DFD02F, 32); //input menu
		break;
	case 4:
		irsend.sendNEC(0x20DFA25D, 32); //quick menu
		break;
	case 5:
		irsend.sendNEC(0x20DF22DD, 32); //ok
		break;
	case 6:
		irsend.sendNEC(0x20DF14EB, 32); //back
		break;
	case 7:
		irsend.sendNEC(0x20DF609F, 32); //arrow right
		break;
	case 8:
		irsend.sendNEC(0x20DFE01F, 32); //arrow left
		break;
	case 9:
		irsend.sendNEC(0x20DF02FD, 32); //arrow up
		break;
	case 10:
		irsend.sendNEC(0x20DF827D, 32); //arrow down
		break;
	case 11:
		irsend.sendNEC(0x20DF40BF, 32); //vol+
		break;
	case 12:
		irsend.sendNEC(0x20DFC03F, 32); //vol-
		break;
	}
}

//Panasonic DVD
BLYNK_WRITE(V18) {
	switch (param.asInt()) {
	case 1:
		irsend.sendRaw(rawDataPower, 99, 32);
		break;
	case 2:
		irsend.sendRaw(rawDataSleep, 99, 32);
		break;
	case 3:
		irsend.sendRaw(rawDataVolUp, 99, 32);
		break;
	case 4:
		irsend.sendRaw(rawDataVolDown, 99, 32);
		break;
	case 5:
		irsend.sendRaw(rawDataSubwoofer, 99, 32);
		break;
	case 6:
		irsend.sendRaw(rawDataAux, 99, 32);
		break;
	case 7:
		irsend.sendRaw(rawDataEq, 99, 32);
		break;
	}
}

void IrSendSubwoofer() {
	irsend.sendRaw(rawDataSubwoofer, 99, 32);
}

void IrSetSubwoofer() { //function required for timer
	int subwooferTimer = timer.setTimer(500, IrSendSubwoofer, 3);
}

//Panasonic DVD Auto Power
BLYNK_WRITE(V19) {
	if (param.asInt() == 1) {
		irsend.sendRaw(rawDataPower, 99, 32);
		timer.setTimeout(2500, IrSetSubwoofer);
	}
}

/* ----- PIR Motion Sensor ----- */

//PIR on/off
BLYNK_WRITE(V20) {
	if (param.asInt()) {
		pirAutoState = true;
	}
	else {
		pirAutoState = false;
	}
}

void CheckPirState() {
	//motion sensor check
	if (pirAutoState) {
		if (digitalRead(pirPin)) {
			pirState = true;
		}
		else {
			pirState = false;
		}
		if (pirAutoLedState) {
			PirScreenState(pirState);
		}
	}//if pirAutoState
}

/* ----------------------------- */


/* ---------- TERMINAL -------- */
BLYNK_WRITE(V10) { //terminal
	if (String("temp") == param.asStr()) {
		terminal.print("Temperatures. Outside local: ");
		terminal.print(tempOut);
		terminal.print("C, Outside ext: ");
		terminal.print(airTemp);
		terminal.print("C, Inside: ");
		terminal.print(tempIn);
		terminal.println("C");
	}

  else if (String("update") == param.asStr()) {
    terminal.println("Updating...");
    UpdateValues();
  }

	else if (String("reboot") == param.asStr()) {
		terminal.println("System is rebooting NOW...");
		ESP.restart();
	}

	else if (String("time") == param.asStr()) {
		terminal.print("Local time: ");
		terminal.print(hour());
		terminal.print(":");
		terminal.println(minute());
	}

	else if (String("uptime") == param.asStr()) {
		terminal.print("Uptime: ");
		terminal.print((millis() / 3600000) / 24);
		terminal.print(" days, ");
		terminal.print((millis() / 3600000) % 24);
		terminal.println(" hours ");
	}

	else if (StartsWith(param.asStr(), "push")) {
		terminal.print("\nWriting on LCD: ");
		String output = param.asStr();
		output.remove(0, 5);
		terminal.println(output);
		timer.restartTimer(updateValuesTimer); //LCD Timer
    display.setFont(&FreeSans9pt7b);
		PrintTextOnScreen(output, true, 1, 8, 16);
    display.display();
	}

	else {
		// Send it back
		terminal.print("You wrote: ");
		terminal.write(param.getBuffer(), param.getLength());
		terminal.print("\nAvailable commands: push, reboot, temp, time, uptime");
		terminal.println();
	}

	// Ensure everything is sent
	terminal.flush();
}
/* ---------------------------------------- */


/* ------ DATA FROM EXTERNAL SOURCE  ------- */

BLYNK_WRITE(V1) {
	tempIn = param.asFloat(); // assigning incoming value from pin V1 (temp) to a float variable
}

/* Air condition values */
BLYNK_WRITE(V40) {
	pm25 = param.asInt();
}
BLYNK_WRITE(V41) {
	pm10 = param.asInt();
}
BLYNK_WRITE(V42) {
	airLevel = param.asInt();
}
BLYNK_WRITE(V43) {
	airTemp = param.asFloat();
}
BLYNK_WRITE(V44) {
	caqi = param.asInt();
}
BLYNK_WRITE(V45) {
	weatherLockFan = param.asInt();
}
BLYNK_WRITE(V70) {
	weatherCondPl = param.asString();
}

/* Spotify */
BLYNK_WRITE(V50) {
	/* Play Status */
	if (param[0].asInt()) {
		isSpotifyPlaying = true;
		currentSpotifyArtist = param[1].asStr();
		currentSpotifyTrack = param[2].asStr();
		if (screenMode == 2) {
			ScreenManager(2); //update screen
		}
	}
	else {
		isSpotifyPlaying = false;
	}
}

BLYNK_WRITE(V51) {
	if (spotifyColorEnabled) {
		fill_solid(leds, NUM_LEDS, CRGB(param[0].asInt(), param[1].asInt(), param[2].asInt()));
		FastLED.show();
	}
}

BLYNK_WRITE(V52) {
	if (param.asInt()) {
		spotifyColorEnabled = true;
	}
	else {
		spotifyColorEnabled = false;
	}
}

/* ------------ External Radiator (bridge) ----------------- */

void CheckRadiatorStatus() {
	bridgeWemos.virtualWrite(V20, 9); //send request for a status
}

void VerifyRadiatorStatus() {
	if (radiatorLocalLevel != radiatorStatus) {
		//send alert, try again
		Blynk.notify("Radiator is out of sync");
		SendRadiatorLevel(radiatorLocalLevel);
	}
}

unsigned char CalculateRadiatorLevel(float tempTarget) {
	if ((tempTarget - tempIn > 0.3) && (tempTarget - tempIn < 1)) { //0.3-1 degree difference: level 3 (should be 1)
		return 3;
	}
	else if ((tempTarget - tempIn >= 1) && (tempTarget - tempIn < 2)) { //1-2 degree difference: level 3 (should be 2)
		return 3;
	}
	else if ((tempTarget - tempIn >= 2) && (tempTarget - tempIn < 20)) { //2-20 degree difference: level 3
		return 3;
	}
	else { //disable radiator: lvl 0
		return 0;
	}
}

void SetRadiatorLevel() {
	if (radiatorAuto) {
		if ((ownerIsHomeSetting && ownerIsHome) || (!ownerIsHomeSetting)) { //based on phone WiFi connection, don't respect if setting is disabled
			if (radiatorTargetTemp >= 10 && radiatorTargetTemp <= 30) {
				radiatorLocalLevel = CalculateRadiatorLevel(radiatorTargetTemp);
				if (radiatorLocalLevel != radiatorStatus) {
					SendRadiatorLevel(radiatorLocalLevel); //should get correct response from device
				}
			}
		}
		else if (ownerIsHomeSetting && !ownerIsHome) { //send 0 if owner not home and setting is enabled
			radiatorLocalLevel = 0;
			if (radiatorLocalLevel != radiatorStatus) {
				SendRadiatorLevel(0); //should get correct response from device
			}
		}
	}
}

void SendRadiatorLevel(unsigned int radiatorLevelToSet) {
	bridgeWemos.virtualWrite(V21, radiatorLevelToSet);
	Blynk.virtualWrite(V66, radiatorLevelToSet); //info about current local level (for app)
	timer.setTimeout(10000L, VerifyRadiatorStatus);
}

BLYNK_WRITE(V61) { //auto radiator based on temperature on/off
	if (param.asInt()) {
		radiatorAuto = true;
	}
	else {
		radiatorAuto = false;
	}
}
BLYNK_WRITE(V62) { //set target temperature
	int targetTemp = param.asInt();
	if (targetTemp > 10 && targetTemp < 30) {
		radiatorTargetTemp = param.asInt();
	}
}

BLYNK_WRITE(V63) { //get first status from Radiator (bridge)
	/* 0 - lvl 0
	1 - lvl 1
	2 - lvl 2
	3 - lvl 3
	10 - ready
	*/
	radiatorStatus = param.asInt();
	if (radiatorStatus >= 0 && radiatorStatus <= 10) {
		SetRadiatorLevel();
	}
}


BLYNK_WRITE(V64) { //get confirmation (last) status from Radiator (bridge)
	/* 0 - lvl 0
	1 - lvl 1
	2 - lvl 2
	3 - lvl 3
	*/
	radiatorStatus = param.asInt();
}

BLYNK_WRITE(V65) { //owner home setting
	if (param.asInt()) {
		ownerIsHomeSetting = true;
	}
	else {
		ownerIsHomeSetting = false;
	}
}

/* -------- Data Update --------- */
void UpdateValues()
{
	//update status on LED
	CRGB previousColor = leds[1];
	leds[1] = CRGB(0, 255, 42);
	FastLED.show();

	sensors.requestTemperatures();
	tempOut = temperatureSensors.getTempC(OutsideTemp);

	if ((tempOut < 85) && (tempOut != 0) && (tempOut > -70)) {
		tempLocalOutWrong = false;
		Blynk.virtualWrite(V2, tempOut);

		//FAN AUTO TURN
		if ((airTemp != 0) && (weatherLockFan != 1) && (!fanLock)) {
			float isTempWrong = airTemp - tempOut;
			if ((isTempWrong > 1.0) || (isTempWrong < -1.0)) {
				digitalWrite(0, HIGH);
			}
			else {
				digitalWrite(0, LOW);
			}
		}
		else {
			digitalWrite(0, LOW);
		}
	}
	else {
		tempLocalOutWrong = true;
	}

	//FAN VIRTUAL LED AND VAR STATE
	if (digitalRead(0) == HIGH) {
		fanState = true;
		Blynk.virtualWrite(V27, 1023);
	}
	else {
		fanState = false;
		Blynk.virtualWrite(V27, 0);
	}

	//UPTIME in hours
	Blynk.virtualWrite(V6, millis() / 3600000);

	//Update OLED
	if (isSpotifyPlaying) {
		ScreenManager(2);
	}
	else {
		ScreenManager(0, halfTime);
    if(!halfTime) {
      halfTime = true;
    }
    else {
      halfTime = false;
    }
	}

	//restore led color
	leds[1] = previousColor;
	FastLED.show();

	//Radiator
	CheckRadiatorStatus();
}

void CheckButtonState() {
	if (digitalRead(button1) == LOW) {
		if (screenMode == 2) {
			ScreenManager(0);
		}
		else if (screenMode == 0) {
			ScreenManager(2);
		}
	}
}

void RestartTrackScroll() {
	scrollTextEnabled = true;
}

void FastTimer() {
	//timer for very frequent, constant actions (like screen animations)
	if (screenMode == 2) { //spotify screen
		if (spotifyTrackScroll && scrollTextEnabled) {
			//missingChars = currentSpotifyTrack.length()-15;
			currentSpotifyTrackScreen = currentSpotifyTrack.substring(0 + spotifyScreenOffset, 14 + spotifyScreenOffset);
			spotifyScreenOffset++;
			if (spotifyScreenOffset > currentSpotifyTrack.length()) { //add 14 to eliminate blank space after scroll
				spotifyScreenOffset = 0;
				timer.setTimeout(2000, RestartTrackScroll);
				FastTimer();
				scrollTextEnabled = false;
			}
			ScreenManager(2);
		}

	}

	CheckButtonState();
}

/* -------------------------------------- */

void setup()
{
	pinMode(pirPin, INPUT);
	pinMode(button1, INPUT);
	pinMode(blindDownPin, OUTPUT);
	pinMode(blindUpPin, OUTPUT);
	pinMode(0, OUTPUT);
	digitalWrite(pirPin, LOW);
	digitalWrite(blindDownPin, LOW);
	digitalWrite(blindUpPin, LOW);
	digitalWrite(0, LOW);

	/* OLED */
	display.begin(SSD1306_SWITCHCAPVCC, 0x3C);  // initialize with the I2C addr 0x3D (for the 128x64)
	display.setRotation(2); //rotate 180deg
	display.setTextColor(WHITE);
	display.display();
	ScreenManager(1); //bootscreen

	/* FastLED */
	FastLED.addLeds<NEOPIXEL, LED_PIN>(leds, NUM_LEDS);
	FastLED.setBrightness(BRIGHTNESS);
	fill_solid(leds, NUM_LEDS, CRGB(17, 128, 108));
	FastLED.show();


	/* ----- Initialization ---- */
	Blynk.begin(auth, SECRET_SSID, SECRET_PASS, SECRET_SERVER_URL);
	int myTimeout = millis() / 1000;
	while (Blynk.connect() == false) { // try to connect to server for 10 seconds
		if ((millis() / 1000) > myTimeout + 8) { // try local server if not connected within 9 seconds
			break;
		}
	}

	irsend.begin();

	/* SET virtual pins options */
	// Auto pir button
	if (pirAutoState) {
		Blynk.virtualWrite(V20, 1);
	}
	else {
		Blynk.virtualWrite(V20, 0);
	}

	/* Timers config */
	updateValuesTimer = timer.setInterval(30000L, UpdateValues);
	fastTimer = timer.setInterval(500L, FastTimer);
	pirTimer = timer.setInterval(200L, CheckPirState);

	/* ----------- OTA ------------- */
	ArduinoOTA.setHostname(DEVICE_NAME);
	ArduinoOTA.onStart([]() {
		PrintTextOnScreen("FLASHING", true, 2, 23, 16);
		display.display();
		fill_solid(leds, NUM_LEDS, CRGB::Red);
		FastLED.show();
	});
	ArduinoOTA.begin();

	/* Terminal Init */
	terminal.println(F("\nBlynk v" BLYNK_VERSION ": Device ESP-12-01 started, software v" SOFT_VERSION));
	terminal.flush();

	setSyncInterval(60000); //RTC Sync
}

BLYNK_CONNECTED() {
	rtc.begin();
	Blynk.syncVirtual(V0, V1, V2, V3, V4, V5, V6, V9, V12, V16, V40, V41, V42, V43, V44, V45, V46, V47, V48, V49, V50, V52, V61, V62, V65, V70, V71, V72);

	if (bootCounter == false) {
		PrintTextOnScreen("LOADING", false, 1, 45, 0);
		display.display();
		fill_solid(leds, NUM_LEDS, CRGB(0, 255, 42));
		FastLED.show();
		bootCounter = true;
	}
	else {
    UpdateValues();
		fill_solid(leds, NUM_LEDS, CRGB(0, 0, 0));
		FastLED.show();
		ScreenManager(0);
	}
	// Bridge with WEMOS-RADIATOR
	bridgeWemos.setAuthToken(BRIDGE_WEMOS_APIKEY);
}


void loop()
{
	Blynk.run();
	timer.run();
	yield();
	ArduinoOTA.handle();
}
